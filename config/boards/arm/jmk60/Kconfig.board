## config/boards/arm/jmk60/Kconfig.board
```kconfig
# Copyright (c) 2021 Nick Winans
# SPDX-License-Identifier: MIT

config BOARD_JMK60
	bool "jmk60"
	depends on SOC_NRF52840_QIAA
```

## config/boards/arm/jmk60/jmk60_defconfig
```kconfig
# Copyright (c) 2021 Nick Winans
# SPDX-License-Identifier: MIT
#改名字 
CONFIG_SOC_SERIES_NRF52X=y
CONFIG_SOC_NRF52840_QIAA=y
CONFIG_BOARD_JMK60=y

# Enable MPU
CONFIG_ARM_MPU=y

# enable GPIO
CONFIG_GPIO=y

CONFIG_USE_DT_CODE_PARTITION=y
CONFIG_BUILD_OUTPUT_UF2=y

CONFIG_MPU_ALLOW_FLASH_WRITE=y
CONFIG_NVS=y
CONFIG_SETTINGS_NVS=y
CONFIG_FLASH=y
CONFIG_FLASH_PAGE_LAYOUT=y
CONFIG_FLASH_MAP=y

CONFIG_ZMK_RGB_UNDERGLOW=y
CONFIG_WS2812_STRIP=y

CONFIG_ZMK_RGB_UNDERGLOW_HUE_START=160
CONFIG_ZMK_RGB_UNDERGLOW_EFF_START=3

#BLE CLEAN
CONFIG_ZMK_BLE_CLEAR_BONDS_ON_START=y

#BLE passkey
CONFIG_ZMK_BLE_PASSKEY_ENTRY=n 

#EXT POWER
CONFIG_ZMK_EXT_POWER=y

#BLE POWER
CONFIG_ZMK_IDLE_TIMEOUT=30000
CONFIG_ZMK_SLEEP=y
CONFIG_ZMK_IDLE_SLEEP_TIMEOUT=900000
```
